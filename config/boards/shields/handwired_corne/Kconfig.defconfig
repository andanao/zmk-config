## config/boards/shields/handwired_corne/Kconfig.defconfig
```kconfig
if SHIELD_HANDWIRED_CORNE_LEFT

config ZMK_KEYBOARD_NAME
    default "adrian_corne_hw"

config ZMK_SPLIT_ROLE_CENTRAL
    default y

endif

if SHIELD_HANDWIRED_CORNE_LEFT || SHIELD_HANDWIRED_CORNE_RIGHT

config ZMK_SPLIT
    default y

endif
```

## config/boards/shields/handwired_corne/Kconfig.shield
```kconfig
config SHIELD_HANDWIRED_CORNE_LEFT
    def_bool $(shields_list_contains,handwired_corne_left)

config SHIELD_HANDWIRED_CORNE_RIGHT
    def_bool $(shields_list_contains,handwired_corne_right)
```
