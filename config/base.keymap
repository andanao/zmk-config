/*
 * Shared keymap for all boards in this repository.
 *
 * Every layer is defined exactly once, for 36 keys (3x5+3), using the
 * standardized key labels from zmk-helpers. Each board has a small entry
 * keymap (e.g. corne.keymap) that maps these eight 36-key blocks onto its
 * physical grid and then includes this file. See AGENTS.md.
 */

// ZMK's built-in default combo timeout, set explicitly so the migration off
// zmk-nodefree-config did not silently change combo timing (zmk-helpers would
// otherwise default it to 30ms). Must precede helper.h, which only defines it
// if unset.
#define COMBO_TERM 50

#include <behaviors.dtsi>
#include <dt-bindings/zmk/keys.h>
#include <zmk-helpers/helper.h> // Requires the zmk-helpers module.

#ifdef CONFIG_WIRELESS
  #include <dt-bindings/zmk/bt.h>
  #define _BT_SEL_KEYS_                                                        \
      &bt BT_SEL 0 &bt BT_SEL 1 &bt BT_SEL 2 &bt BT_SEL 3 &bt BT_SEL 4
  #define BT_CLEAR &bt BT_CLR
#else
  #define _BT_SEL_KEYS_ &none &none &none &none &none
  #define BT_CLEAR &none
#endif

/* Layers */

#define DEF   0
#define NAV   1
#define NUM   2
#define ADMIN 3

#define XXX &none
#define ___ &trans

/* Combos */

#include "combos.dtsi"

/* Keymap */

// Boards with exactly 36 keys need no adapter; anything else defines its own
// ZMK_BASE_LAYER before including this file.
#ifndef ZMK_BASE_LAYER
  #define ZMK_BASE_LAYER(name, LT, RT, LM, RM, LB, RB, LH, RH)                 \
      ZMK_LAYER(name, LT RT LM RM LB RB LH RH)
#endif

ZMK_BASE_LAYER(Base,
//╭─────────────┬─────────────┬─────────────┬─────────────┬─────────────╮ ╭─────────────┬─────────────┬─────────────┬─────────────┬─────────────╮
    &kp Q         &kp W         &kp E         &kp R         &kp T       ,   &kp Y         &kp U         &kp I         &kp O         &kp P       ,
//├─────────────┼─────────────┼─────────────┼─────────────┼─────────────┤ ├─────────────┼─────────────┼─────────────┼─────────────┼─────────────┤
    &kp A         &kp S         &kp D         &kp F         &kp G       ,   &kp H         &kp J         &kp K         &kp L         &kp SEMI    ,
//├─────────────┼─────────────┼─────────────┼─────────────┼─────────────┤ ├─────────────┼─────────────┼─────────────┼─────────────┼─────────────┤
    &kp Z         &kp X         &kp C         &kp V         &kp B       ,   &kp N         &kp M         &kp COMMA     &kp DOT       &kp FSLH    ,
//╰─────────────┴─────────────┴──╮────────────┼─────────────┼───────────┤ ├─────────────┼─────────────┼──╭───────────┴─────────────┴─────────────╯
                                            &kp LSHFT     &lt NUM TAB   ,   &mo NAV       &kp SPACE
//                              ╰─────────────┴─────────────┴───────────╯ ╰─────────────┴─────────────┴─────────────╯
)

ZMK_BASE_LAYER(Nav,
//╭─────────────┬─────────────┬─────────────┬─────────────┬─────────────╮ ╭─────────────┬─────────────┬─────────────┬─────────────┬─────────────╮
    XXX           XXX           XXX           XXX           XXX         ,   XXX           XXX           XXX           XXX           XXX         ,
//├─────────────┼─────────────┼─────────────┼─────────────┼─────────────┤ ├─────────────┼─────────────┼─────────────┼─────────────┼─────────────┤
    XXX           XXX           XXX           XXX           XXX         ,   &kp LEFT      &kp DOWN      &kp UP        &kp RIGHT     XXX         ,
//├─────────────┼─────────────┼─────────────┼─────────────┼─────────────┤ ├─────────────┼─────────────┼─────────────┼─────────────┼─────────────┤
    XXX           XXX           XXX           XXX           XXX         ,   XXX           XXX           XXX           XXX           XXX         ,
//╰─────────────┴─────────────┴──╮────────────┼─────────────┼───────────┤ ├─────────────┼─────────────┼──╭───────────┴─────────────┴─────────────╯
                                            ___           ___           ,   ___           ___
//                              ╰─────────────┴─────────────┴───────────╯ ╰─────────────┴─────────────┴─────────────╯
)

ZMK_BASE_LAYER(Num,
//╭─────────────┬─────────────┬─────────────┬─────────────┬─────────────╮ ╭─────────────┬─────────────┬─────────────┬─────────────┬─────────────╮
    XXX           XXX           XXX           XXX           XXX         ,   &kp ASTERISK  &kp N7        &kp N8        &kp N9        &kp SLASH   ,
//├─────────────┼─────────────┼─────────────┼─────────────┼─────────────┤ ├─────────────┼─────────────┼─────────────┼─────────────┼─────────────┤
    XXX           XXX           XXX           XXX           XXX         ,   &kp MINUS     &kp N4        &kp N5        &kp N6        &kp COLON   ,
//├─────────────┼─────────────┼─────────────┼─────────────┼─────────────┤ ├─────────────┼─────────────┼─────────────┼─────────────┼─────────────┤
    XXX           XXX           XXX           XXX           XXX         ,   &kp DOT       &kp N1        &kp N2        &kp N3        &kp COMMA   ,
//╰─────────────┴─────────────┴──╮────────────┼─────────────┼───────────┤ ├─────────────┼─────────────┼──╭───────────┴─────────────┴─────────────╯
                                            &kp LS(TAB)   &kp TAB       ,   &kp N0        &kp SPACE
//                              ╰─────────────┴─────────────┴───────────╯ ╰─────────────┴─────────────┴─────────────╯
)

ZMK_BASE_LAYER(Admin,
//╭─────────────┬─────────────┬─────────────┬─────────────┬─────────────╮ ╭─────────────┬─────────────┬─────────────┬─────────────┬─────────────╮
                               _BT_SEL_KEYS_                            ,   XXX           &sys_reset    XXX           XXX           BT_CLEAR    ,
//├─────────────┼─────────────┼─────────────┼─────────────┼─────────────┤ ├─────────────┼─────────────┼─────────────┼─────────────┼─────────────┤
    &kp F1        &kp F2        &kp F3        &kp F4        &kp F5      ,   &kp C_PREV    &kp C_VOL_DN  &kp C_VOL_UP  &kp C_NEXT    XXX         ,
//├─────────────┼─────────────┼─────────────┼─────────────┼─────────────┤ ├─────────────┼─────────────┼─────────────┼─────────────┼─────────────┤
    &kp F6        &kp F7        &kp F8        &kp F9        &kp F10     ,   &kp F11       &kp F12       XXX           XXX           XXX         ,
//╰─────────────┴─────────────┴──╮────────────┼─────────────┼───────────┤ ├─────────────┼─────────────┼──╭───────────┴─────────────┴─────────────╯
                                            XXX           XXX           ,   XXX           &kp C_PP
//                              ╰─────────────┴─────────────┴───────────╯ ╰─────────────┴─────────────┴─────────────╯
)
