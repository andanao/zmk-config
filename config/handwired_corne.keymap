/*
 * Handwired 5-column Corne.
 *
 * 36 physical keys against a 34-key shared keymap, so the only padding needed
 * is the outer thumb on each half — which is physically removed, hence &none.
 */

#define CONFIG_WIRELESS

#define OUTER_TH &none // outer thumb on both halves

#define ZMK_BASE_LAYER(name, LT, RT, LM, RM, LB, RB, LH, RH)                   \
    ZMK_LAYER(name, LT RT LM RM LB RB OUTER_TH LH RH OUTER_TH)

#include <zmk-helpers/key-labels/36.h>
#include "base.keymap"
